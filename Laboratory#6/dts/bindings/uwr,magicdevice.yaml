## Laboratory#6/dts/bindings/uwr,magicdevice.yaml
```yaml
description: "hehehehehehe"

compatible: "uwr,magicdevice"

properties:
  up_gpios:
    type: phandle-array
    required: true
  left_gpios:
    type: phandle-array
    required: true
  down_gpios:
    type: phandle-array
    required: true
  right_gpios:
    type: phandle-array
    required: true
  button_gpios:
    type: phandle-array
    required: true
  accelerometer:
    type: phandle
    required: true
  
```
